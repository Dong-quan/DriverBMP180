/dts-v1/;
/plugin/;

/ {
    compatible = "brcm,bcm2835";

    fragment@0 {
        target-path = "/soc/i2c@7e804000";
        __overlay__ {
            #address-cells = <1>;
            #size-cells = <0>;

            bmp180@77 {
                compatible = "thiennhan,bmp180";
                reg = <0x77>;
                status = "okay";
            };
        };
    };
};

